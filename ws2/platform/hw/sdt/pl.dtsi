/ {
	amba_pl: amba_pl {
		ranges;
		compatible = "simple-bus";
		#address-cells = <1>;
		#size-cells = <1>;
		firmware-name = "design_1_wrapper.bit.bin";
		clocking0: clocking0 {
			compatible = "xlnx,fclk";
			assigned-clocks = <&clkc 15>;
			assigned-clock-rates = <50000000>;
			#clock-cells = <0>;
			clock-output-names = "fabric_clk";
			clocks = <&clkc 15>;
		};
		logmapAXI_0: logmapAXI@40000000 {
			xlnx,s00-axi-data-width = <32>;
			compatible = "xlnx,logmapAXI-1.0";
			status = "okay";
			clock-names = "s00_axi_aclk";
			xlnx,s00-axi-addr-width = <5>;
			xlnx,ip-name = "logmapAXI";
			xlnx,edk-iptype = "PERIPHERAL";
			reg = <0x40000000 0x1000>;
			clocks = <&clkc 15>;
			xlnx,name = "logmapAXI_0";
		};
	};
};
